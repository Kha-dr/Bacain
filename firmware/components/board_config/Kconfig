## firmware/components/board_config/Kconfig
```kconfig
menu "Board & Hardware Configuration"

    choice BOARD_PROFILE
        prompt "Hardware Board Profile"
        default BOARD_PROFILE_WAVESHARE_154
        help
            Select the target hardware board profile.

        config BOARD_PROFILE_WAVESHARE_154
            bool "Waveshare ESP32-S3-ePaper-1.54"

        config BOARD_PROFILE_CUSTOM
            bool "Custom / Manual Configuration"
    endchoice

    config BOARD_ALQURAN_ENABLE
        bool "Enable Al-Quran reader (.bqm engine)"
        default n
        help
            Compiles the Al-Quran menu, .bqm reader, and independent NVS/RTC
            Tilawah state. Enabled via sdkconfig.alquran overlay only.

    config BOARD_DISPLAY_WIDTH
        int "Display width in pixels"
        default 200
        range 64 1024
        help
            Width of the E-Paper display in pixels.
            Default: 200 (Waveshare ESP32-S3-ePaper-1.54).

    config BOARD_DISPLAY_HEIGHT
        int "Display height in pixels"
        default 200
        range 64 1024
        help
            Height of the E-Paper display in pixels.
            Default: 200 (Waveshare ESP32-S3-ePaper-1.54).

    config BOARD_DISPLAY_ROTATION
        int "Display rotation (0: upright portrait, 1: 90 deg, 2: 180 deg, 3: 270 deg)"
        default 0
        range 0 3
        help
            Default display orientation.
            Default: 0 (upright portrait, Waveshare ESP32-S3-ePaper-1.54).

    config BOARD_EPD_DC_PIN
        int "E-Paper DC GPIO pin"
        default 10
        help
            GPIO pin for E-Paper Data/Command selection.
            Default: 10 (Waveshare ESP32-S3-ePaper-1.54).

    config BOARD_EPD_CS_PIN
        int "E-Paper CS GPIO pin"
        default 11
        help
            GPIO pin for E-Paper SPI Chip Select.
            Default: 11 (Waveshare ESP32-S3-ePaper-1.54).

    config BOARD_EPD_SCK_PIN
        int "E-Paper SCK GPIO pin"
        default 12
        help
            GPIO pin for E-Paper SPI Clock.
            Default: 12 (Waveshare ESP32-S3-ePaper-1.54).

    config BOARD_EPD_MOSI_PIN
        int "E-Paper MOSI GPIO pin"
        default 13
        help
            GPIO pin for E-Paper SPI MOSI.
            Default: 13 (Waveshare ESP32-S3-ePaper-1.54).

    config BOARD_EPD_RST_PIN
        int "E-Paper Reset GPIO pin"
        default 9
        help
            GPIO pin for E-Paper Reset.
            Default: 9 (Waveshare ESP32-S3-ePaper-1.54).

    config BOARD_EPD_BUSY_PIN
        int "E-Paper Busy GPIO pin"
        default 8
        help
            GPIO pin for E-Paper Busy status.
            Default: 8 (Waveshare ESP32-S3-ePaper-1.54).

    config BOARD_EPD_PWR_PIN
        int "E-Paper Power Control GPIO pin"
        default 6
        help
            GPIO pin to control E-Paper power rail.
            Default: 6 (Waveshare ESP32-S3-ePaper-1.54).

    config BOARD_BTN_UP_PIN
        int "Navigation Up / Prev Button GPIO pin (BOOT)"
        default 0
        help
            GPIO pin for navigation up button.
            Default: 0 (BOOT button on Waveshare ESP32-S3-ePaper-1.54).

    config BOARD_BTN_DOWN_PIN
        int "Navigation Down / Next Button GPIO pin (PWR)"
        default 18
        help
            GPIO pin for navigation down button.
            Default: 18 (PWR button on Waveshare ESP32-S3-ePaper-1.54).

    config BOARD_SDMMC_D0_PIN
        int "MicroSD SDMMC D0 GPIO pin"
        default 40
        help
            GPIO pin for SDMMC Data 0.
            Default: 40 (Waveshare ESP32-S3-ePaper-1.54).

    config BOARD_SDMMC_CLK_PIN
        int "MicroSD SDMMC CLK GPIO pin"
        default 39
        help
            GPIO pin for SDMMC Clock.
            Default: 39 (Waveshare ESP32-S3-ePaper-1.54).

    config BOARD_SDMMC_CMD_PIN
        int "MicroSD SDMMC CMD GPIO pin"
        default 41
        help
            GPIO pin for SDMMC Command.
            Default: 41 (Waveshare ESP32-S3-ePaper-1.54).

    config BOARD_SD_CLK_PIN
        int "MicroSD SD CLK GPIO pin"
        default 14
        help
            GPIO pin for SD Clock.
            Default: 14.

    config BOARD_SD_CMD_PIN
        int "MicroSD SD CMD GPIO pin"
        default 15
        help
            GPIO pin for SD Command.
            Default: 15.

    config BOARD_SD_D0_PIN
        int "MicroSD SD D0 GPIO pin"
        default 16
        help
            GPIO pin for SD Data 0.
            Default: 16.

    config BOARD_VBAT_PWR_HOLD_PIN
        int "VBAT Power Hold GPIO pin"
        default 17
        help
            GPIO pin to maintain battery power.
            Default: 17 (Waveshare ESP32-S3-ePaper-1.54).

    config BOARD_PWR_LATCH_PIN
        int "Power Latch GPIO pin"
        default 17
        help
            GPIO pin to maintain system power latch.
            Default: 17.

    config BOARD_AUDIO_PWR_PIN
        int "Audio Power Control GPIO pin"
        default 42
        help
            GPIO pin for Audio power switch.
            Default: 42 (Waveshare ESP32-S3-ePaper-1.54).

    config BOARD_AUDIO_PA_PIN
        int "Audio Power Amplifier GPIO pin"
        default 46
        help
            GPIO pin for Audio Power Amplifier enable.
            Default: 46 (Waveshare ESP32-S3-ePaper-1.54).

    config BOARD_LED_GREEN_PIN
        int "Status LED GPIO pin"
        default 3
        help
            GPIO pin for green status LED.
            Default: 3 (Waveshare ESP32-S3-ePaper-1.54).

    config BOARD_BATTERY_ADC_CHANNEL
        int "Battery ADC Channel (ADC1)"
        default 3
        help
            ADC1 channel used for battery voltage sensing.
            Default: 3 (Waveshare ESP32-S3-ePaper-1.54).

    config BOARD_I2S_BCLK_PIN
        int "Audio I2S BCLK GPIO pin"
        default 4
        help
            GPIO pin for Audio I2S Bit Clock.
            Default: 4.

    config BOARD_I2S_LRCK_PIN
        int "Audio I2S LRCK GPIO pin"
        default 5
        help
            GPIO pin for Audio I2S Left/Right Clock.
            Default: 5.

    config BOARD_I2S_DOUT_PIN
        int "Audio I2S DOUT GPIO pin"
        default 7
        help
            GPIO pin for Audio I2S Data Out.
            Default: 7.

endmenu
```

## firmware/main/Kconfig.projbuild
```kconfig
menu "BacaIn Application Configuration"

    config APP_SYNC_URL
        string "Web Sync PWA URL"
        default "https://bacain.khadr.dev"
        help
            Target URL displayed as QR code and text on the sync screen.

    config APP_INACTIVITY_SLEEP_SEC
        int "Inactivity Sleep Timeout (seconds)"
        default 60
        range 10 3600
        help
            Device deep sleep timeout after user inactivity.

endmenu
```

## firmware/sdkconfig.defaults
```kconfig
CONFIG_IDF_TARGET="esp32s3"

# Flash settings (8MB)
CONFIG_ESPTOOLPY_FLASHMODE_QIO=y
CONFIG_ESPTOOLPY_FLASHSIZE_8MB=y
CONFIG_PARTITION_TABLE_CUSTOM=y
CONFIG_PARTITION_TABLE_CUSTOM_FILENAME="partitions.csv"

# PSRAM / Octal SPIRAM (8MB)
CONFIG_SPIRAM=y
CONFIG_SPIRAM_MODE_OCT=y
CONFIG_SPIRAM_SPEED_80M=y
CONFIG_SPIRAM_BOOT_INIT=y
CONFIG_SPIRAM_USE_MALLOC=y
CONFIG_SPIRAM_MEMTEST=n

# FreeRTOS & CPU
CONFIG_ESP_DEFAULT_CPU_FREQ_MHZ_240=y
CONFIG_FREERTOS_HZ=1000

# Bluetooth / NimBLE
CONFIG_BT_ENABLED=y
CONFIG_BT_NIMBLE_ENABLED=y
CONFIG_BT_NIMBLE_MAX_CONNECTIONS=1
CONFIG_BT_NIMBLE_ATT_PREFERRED_MTU=512

# FATFS Long Filename & exFAT support
CONFIG_FATFS_LFN_HEAP=y
CONFIG_FATFS_MAX_LFN=255
CONFIG_FATFS_API_ENCODING_UTF_8=y
CONFIG_FATFS_EXFAT=y

# Power Management & Sleep
CONFIG_PM_ENABLE=y
CONFIG_RTC_CLK_SRC_EXT_CRYS=n

# Main task stack size (default 3584 is too small for FATFS and text pager)
CONFIG_ESP_MAIN_TASK_STACK_SIZE=16384
CONFIG_SPIRAM_IGNORE_NOTFOUND=y

# Bootloader & Logging Optimizations
CONFIG_BOOTLOADER_SKIP_VALIDATE_IN_DEEP_SLEEP=y
CONFIG_BOOTLOADER_LOG_LEVEL_WARN=y
CONFIG_LOG_DEFAULT_LEVEL_WARN=y
CONFIG_LOG_MAXIMUM_LEVEL_INFO=y
```
