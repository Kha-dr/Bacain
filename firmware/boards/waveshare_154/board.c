#include <stddef.h>
#include <stdint.h>
#include "board_config.h"
#include "esp_log.h"
#include "driver/gpio.h"

static const char *TAG = "board_waveshare_154";

void board_power_pre_sleep(void) {
    ESP_LOGI(TAG, "Waveshare 1.54 pre-sleep hook");
#if defined(BOARD_AUDIO_PWR_PIN) && (BOARD_AUDIO_PWR_PIN >= 0)
    if (GPIO_IS_VALID_OUTPUT_GPIO(BOARD_AUDIO_PWR_PIN)) {
        gpio_set_level((gpio_num_t)BOARD_AUDIO_PWR_PIN, !BOARD_AUDIO_PWR_ACTIVE_LVL);
    }
#endif
#if defined(BOARD_EPD_PWR_PIN) && (BOARD_EPD_PWR_PIN >= 0)
    if (GPIO_IS_VALID_OUTPUT_GPIO(BOARD_EPD_PWR_PIN)) {
        gpio_set_level((gpio_num_t)BOARD_EPD_PWR_PIN, !BOARD_EPD_PWR_ACTIVE_LVL);
    }
#endif
}

const uint8_t *board_epd_get_lut_full(size_t *out_len)
{
    static const uint8_t s_wf_full_1in54[159] = {
        0x80, 0x48, 0x40, 0x00, 0x00, 0x00, 0x00, 0x00, 0x00, 0x00, 0x00, 0x00,
        0x40, 0x48, 0x80, 0x00, 0x00, 0x00, 0x00, 0x00, 0x00, 0x00, 0x00, 0x00,
        0x80, 0x48, 0x40, 0x00, 0x00, 0x00, 0x00, 0x00, 0x00, 0x00, 0x00, 0x00,
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        0x22, 0x17, 0x41, 0x00, 0x32, 0x20
    };
    if (out_len != NULL) {
        *out_len = sizeof(s_wf_full_1in54);
    }
    return s_wf_full_1in54;
}

const uint8_t *board_epd_get_lut_partial(size_t *out_len)
{
    static const uint8_t s_wf_partial_1in54_0[159] = {
        0x00, 0x40, 0x00, 0x00, 0x00, 0x00, 0x00, 0x00, 0x00, 0x00, 0x00, 0x00,
        0x80, 0x80, 0x00, 0x00, 0x00, 0x00, 0x00, 0x00, 0x00, 0x00, 0x00, 0x00,
        0x40, 0x40, 0x00, 0x00, 0x00, 0x00, 0x00, 0x00, 0x00, 0x00, 0x00, 0x00,
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        0x02, 0x17, 0x41, 0xB0, 0x32, 0x28
    };
    if (out_len != NULL) {
        *out_len = sizeof(s_wf_partial_1in54_0);
    }
    return s_wf_partial_1in54_0;
}
